## app/Kconfig.behaviors
```kconfig
# Copyright (c) 2023 The ZMK Contributors
# SPDX-License-Identifier: MIT

config ZMK_BEHAVIOR_METADATA
    bool "Metadata"
    help
      Enabling this option adds APIs for documenting and fetching
      metadata describing a behavior's name, and supported parameters.

config ZMK_BEHAVIOR_LOCAL_IDS
    bool "Local IDs"

if ZMK_BEHAVIOR_LOCAL_IDS

config ZMK_BEHAVIOR_LOCAL_IDS_IN_BINDINGS
    bool "Track in behavior bindings"

choice ZMK_BEHAVIOR_LOCAL_ID_TYPE
    prompt "Local ID Type"

config ZMK_BEHAVIOR_LOCAL_ID_TYPE_SETTINGS_TABLE
    bool "Settings Table"
    depends on SETTINGS
    select ZMK_BEHAVIOR_LOCAL_IDS_IN_BINDINGS
    help
      Use persistent entries in the settings subsystem to identify
      behaviors by local ID, which uses the device name to generate
      a new settings entry tying a persistent local ID to that name.
      This guarantees stable, collision-free local IDs at the expense
      of settings storage used.

config ZMK_BEHAVIOR_LOCAL_ID_TYPE_CRC16
    bool "CRC16 Hash"
    help
      Use the CRC16-ANSI hash of behavior device names to generate
      stable behavior local IDs. This saves on settings storage at
      the expense of (highly unlikely) risk of collisions.

endchoice

endif

config ZMK_BEHAVIOR_HOLD_TAP
    bool
    default y
    depends on DT_HAS_ZMK_BEHAVIOR_HOLD_TAP_ENABLED

if ZMK_BEHAVIOR_HOLD_TAP

config ZMK_BEHAVIOR_HOLD_TAP_MAX_HELD
    int "Hold Tap Max Held"
    default 10
    help
      Max number of simultaneously held hold-taps

config ZMK_BEHAVIOR_HOLD_TAP_MAX_CAPTURED_EVENTS
    int "Hold Tap Max Captured Events"
    default 40
    help
      Max number of captured system events while waiting to resolve hold taps

endif

config ZMK_BEHAVIOR_KEY_TOGGLE
    bool
    default y
    depends on DT_HAS_ZMK_BEHAVIOR_KEY_TOGGLE_ENABLED

config ZMK_BEHAVIOR_MOUSE_KEY_PRESS
    bool
    default y
    depends on DT_HAS_ZMK_BEHAVIOR_MOUSE_KEY_PRESS_ENABLED
    imply ZMK_MOUSE

config ZMK_BEHAVIOR_STICKY_KEY
    bool
    default y
    depends on DT_HAS_ZMK_BEHAVIOR_STICKY_KEY_ENABLED

if ZMK_BEHAVIOR_STICKY_KEY

config ZMK_BEHAVIOR_STICKY_KEY_MAX_HELD
    int "Sticky Key Max Held"
    default 10
    help
      Max number of simultaneously held sticky keys

endif

config ZMK_BEHAVIOR_SOFT_OFF
    bool
    default y
    depends on DT_HAS_ZMK_BEHAVIOR_SOFT_OFF_ENABLED && ZMK_PM_SOFT_OFF

config ZMK_BEHAVIOR_SENSOR_ROTATE_COMMON
    bool

config ZMK_BEHAVIOR_SENSOR_ROTATE
    bool
    default y
    depends on DT_HAS_ZMK_BEHAVIOR_SENSOR_ROTATE_ENABLED
    select ZMK_BEHAVIOR_SENSOR_ROTATE_COMMON

config ZMK_BEHAVIOR_SENSOR_ROTATE_VAR
    bool
    default y
    depends on DT_HAS_ZMK_BEHAVIOR_SENSOR_ROTATE_VAR_ENABLED
    select ZMK_BEHAVIOR_SENSOR_ROTATE_COMMON

config ZMK_BEHAVIOR_MACRO
    bool
    default y
    depends on DT_HAS_ZMK_BEHAVIOR_MACRO_ENABLED || DT_HAS_ZMK_BEHAVIOR_MACRO_ONE_PARAM_ENABLED || DT_HAS_ZMK_BEHAVIOR_MACRO_TWO_PARAM_ENABLED

# New settings for PIM447 Trackball
config ZMK_BEHAVIOR_TRACKBALL_PIM447
    bool "Enable PIM447 Trackball Support"
    default n
    help
      Enable support for the PIM447 trackball. This option must be enabled
      to use the PIM447 trackball with the ZMK firmware.

if ZMK_BEHAVIOR_TRACKBALL_PIM447

config ZMK_TRACKBALL_PIM447_SENSITIVITY
    int "Trackball Sensitivity"
    default 10
    help
      Set the sensitivity level for the PIM447 trackball. Higher values
      will make the trackball more sensitive to movements.

endif
```

## app/boards/arm/nice_nano/Kconfig
```kconfig
# SPDX-License-Identifier: MIT

config BOARD_ENABLE_DCDC
	bool "Enable DCDC mode"
	select SOC_DCDC_NRF52X
	default y
	depends on (BOARD_NICE_NANO || BOARD_NICE_NANO_V2)

menu "Nice Nano Configuration"

config ZMK_TRACKBALL_PIM447
    bool "Enable ZMK trackball PIM447 support"
    default n
    help
      Enable support for the PIM447 trackball sensor in ZMK.

source "drivers/zephyr/Kconfig"
source "boards/shields/corne/Kconfig"
# Add other relevant Kconfig files here

endmenu
```

## app/boards/shields/corne/Kconfig
```kconfig
config ZMK_TRACKBALL_PIM447
    bool "Enable ZMK trackball PIM447 support"
    default n
    help
      Enable support for the PIM447 trackball sensor on this board/shield.
      Ensure that the board or shield supports the PIM447 sensor and configure it accordingly.
```

## app/drivers/sensor/Kconfig
```kconfig
# Copyright (c) 2020 The ZMK Contributors
# SPDX-License-Identifier: MIT

source "battery/Kconfig"
source "ec11/Kconfig"
source "trackball_pim447/Kconfig"
```

## app/drivers/sensor/trackball_pim447/Kconfig
```kconfig
config ZMK_TRACKBALL_PIM447
    bool "Enable PIM447 Trackball"
    default y
    help
      Enable support for the PIM447 Trackball sensor.
```

## app/dts/bindings/pimoroni,trackball_pim447.yaml
```yaml
# zmk/app/dts/bindings/pimoroni,trackball_pim447.yaml

$schema: http://devicetree.org/meta-schemas/base.yaml
title: Pimoroni Trackball PIM447

pimoroni,trackball_pim447:
  type: object
  properties:
    compatible:
      const: "pimoroni,trackball_pim447"
    reg:
      description: "I2C address of the trackball"
      type: integer
      minimum: 0
      maximum: 127  # I2C 주소 범위에 따라 조정 가능
    move-factor:
      description: "Pointer movement factor"
      type: integer
      default: 1
    button:
      description: "Button configuration"
      type: integer
      default: 0
    scroll-divisor:
      description: "Scroll wheel divisor"
      type: integer
      default: 1
    mode:
      description: "Trackball mode"
      type: integer
      default: 0
  required:
    - compatible
    - reg
  additionalProperties: false
```

## app/dts/bindings/pimoroni/pimoroni,trackball_pim447.yaml
```yaml
# zmk/app/dts/bindings/pimoroni/pimoroni,trackball_pim447.yaml
$id: "pimoroni,trackball_pim447"
$schema: "http://devicetree.org/schemas/dt-schema.yaml#"

title: "Pimoroni Trackball PIM447"

description: |
  Device Tree bindings for the Pimoroni Trackball PIM447.

properties:
  compatible:
    const: "pimoroni,trackball_pim447"

required:
  - compatible
```

## config/Kconfig.defconfig
```kconfig
if SHIELD_CORNE_RIGHT

// 키보드 이름을 "Corne"로 설정
config ZMK_KEYBOARD_NAME
    default "Corne"

// 키보드 역할을 중앙(Central)으로 설정
config ZMK_SPLIT_ROLE_CENTRAL
    default y

// 트랙볼 기능을 활성화
config TRACKBALL_ENABLED
    default y

// 트랙볼의 X 및 Y 축 핀 설정 (SCL과 SDA 핀 번호)
config TRACKBALL_X_PIN
    default <20>  // SCL 핀 번호 P0.20
config TRACKBALL_Y_PIN
    default <17>  // SDA 핀 번호 P0.17

endif // SHIELD_CORNE_RIGHT 조건 끝

if SHIELD_CORNE_LEFT || SHIELD_CORNE_RIGHT

// 분할 키보드 기능을 활성화
config ZMK_SPLIT
    default y

// 디스플레이 관련 설정이 활성화되어 있는 경우
if ZMK_DISPLAY

// I2C 통신 기능을 활성화
config I2C
    default y

// SSD1306 디스플레이 드라이버를 활성화
config SSD1306
    default y

endif // ZMK_DISPLAY 조건 끝

if LVGL

// VDB(Variable Display Buffer) 크기를 64로 설정
config LV_Z_VDB_SIZE
    default 64

// 기본 DPI(Dots Per Inch)를 148로 설정
config LV_DPI_DEF
    default 148

// Z 축 비트당 픽셀 수를 1로 설정
config LV_Z_BITS_PER_PIXEL
    default 1

// 색 깊이 선택 설정
choice LV_COLOR_DEPTH
    // 기본 색 깊이를 1로 설정 (흑백)
    default LV_COLOR_DEPTH_1
endchoice // 색 깊이 선택 끝

endif // LVGL 조건 끝

endif // SHIELD_CORNE_LEFT || SHIELD_CORNE_RIGHT 조건 끝
```

## config/west.yml
```yaml
manifest:
  remotes:
    - name: zmkfirmware
      url-base: https://github.com/zmkfirmware
  projects:
    - name: zmk-config
      remote: zmkfirmware
      path: zmk-config
      revision: main
  self:
    west-commands: scripts/west-commands.yml
```
